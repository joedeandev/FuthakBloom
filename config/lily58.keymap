#include <behaviors.dtsi>
#include <dt-bindings/zmk/keys.h>
#define LT0 17
#define LT1 16
#define LT2 15
#define LT3 14
#define LT4 13
#define LT5 12
#define RT0 18
#define RT1 19
#define RT2 20
#define RT3 21
#define RT4 22
#define RT5 23
#define LM0 29
#define LM1 28
#define LM2 27
#define LM3 26
#define LM4 25
#define LM5 24
#define RM0 30
#define RM1 31
#define RM2 32
#define RM3 33
#define RM4 34
#define RM5 35
#define LB0 41
#define LB1 40
#define LB2 39
#define LB3 38
#define LB4 37
#define LB5 36
#define RB0 44
#define RB1 45
#define RB2 46
#define RB3 47
#define RB4 48
#define RB5 49
#define LBC 42
#define RBC 43
#define LH0 53
#define LH1 52
#define LH2 51
#define LH3 50
#define RH0 54
#define RH1 55
#define RH2 56
#define RH3 57

//                    ┌───────────────────────────────────────────────────────────────────────────────────────────────────────────────────────────────────────────────────────────────────────────────────────────────────────────────────────────────────┐
//                                                                                                                              EXTRA: LAYER ZERO                                                                                                          
// UPPER ROW          ├──────────────────┬──────────────────┬──────────────────┬──────────────────┬──────────────────┬──────────────────┬──────────────────┬──────────────────┬──────────────────┬──────────────────┬──────────────────┬──────────────────┤
#define X_UPR0          &kp ESCAPE         &kp NUMBER_1       &kp NUMBER_2       &kp NUMBER_2       &kp NUMBER_3       &kp NUMBER_4       &kp NUMBER_5       &kp NUMBER_6       &kp NUMBER_7       &kp NUMBER_8       &kp NUMBER_9       &kp PRINTSCREEN   
// TOP LEFT           ├──────────────────┼──────────────────┼──────────────────┼──────────────────┼──────────────────┼──────────────────┼──────────────────┼──────────────────┼──────────────────┼──────────────────┼──────────────────┼──────────────────┤
#define X_LTP0          &kp TAB                                                                                                                                                                                                                            
// TOP MIDDLE         │                  │                  │                  │                  │                  │                  │                  │                  │                  │                  │                  │                  │
#define X_MTP0                                                                                                                                                                                                                                             
// TOP RIGHT          │                  │                  │                  │                  │                  │                  │                  │                  │                  │                  │                  │                  │
#define X_RTP0                                                                                                                                                                                                                           &kp BACKSPACE     
// MIDDLE LEFT        ├──────────────────┼──────────────────┼──────────────────┼──────────────────┼──────────────────┼──────────────────┼──────────────────┼──────────────────┼──────────────────┼──────────────────┼──────────────────┼──────────────────┤
#define X_LMD0          &kp CAPSLOCK                                                                                                                                                                                                                       
// MIDDLE MIDDLE      │                  │                  │                  │                  │                  │                  │                  │                  │                  │                  │                  │                  │
#define X_MMD0                                                                                                                                                                                                                                             
// MIDDLE RIGHT       │                  │                  │                  │                  │                  │                  │                  │                  │                  │                  │                  │                  │
#define X_RMD0                                                                                                                                                                                                                           &kp RETURN        
// BOTTOM LEFT        ├──────────────────┼──────────────────┼──────────────────┼──────────────────┼──────────────────┼──────────────────┼──────────────────┼──────────────────┼──────────────────┼──────────────────┼──────────────────┼──────────────────┤
#define X_LBM0          &kp LEFT_SHIFT                                                                                                                                                                                                                     
// BOTTOM MIDDLE      │                  │                  │                  │                  │                  │                  │                  │                  │                  │                  │                  │                  │
#define X_MBM0                                                                                                         &kp LEFT_BRACKET   &kp RIGHT_BRACKET                                                                                                
// BOTTOM RIGHT       │                  │                  │                  │                  │                  │                  │                  │                  │                  │                  │                  │                  │
#define X_RBM0                                                                                                                                                                                                                           &kp RIGHT_SHIFT   
// THUMB LEFT         ├──────────────────┼──────────────────┼──────────────────┼──────────────────┼──────────────────┼──────────────────┼──────────────────┼──────────────────┼──────────────────┼──────────────────┼──────────────────┼──────────────────┤
#define X_LTM0          &kp LEFT_ALT       &kp LEFT_GUI                                                                                                                                                                                                    
// THUMB MIDDLE       │                  │                  │                  │                  │                  │                  │                  │                  │                  │                  │                  │                  │
#define X_MTM0                                                                                                                                                                                                                                             
// THUMB RIGHT        │                  │                  │                  │                  │                  │                  │                  │                  │                  │                  │                  │                  │
#define X_RTM0                                                                                                                                                                                                        &kp BACKSPACE      &kp RIGHT_GUI     
// BOTTOM ROW         ├──────────────────┼──────────────────┼──────────────────┼──────────────────┼──────────────────┼──────────────────┼──────────────────┼──────────────────┼──────────────────┼──────────────────┼──────────────────┼──────────────────┤
#define X_LWR0                                                                                                                                                                                                                                             
//                    └──────────────────┴──────────────────┴──────────────────┴──────────────────┴──────────────────┴──────────────────┴──────────────────┴──────────────────┴──────────────────┴──────────────────┴──────────────────┴──────────────────┘

// Add sensor bindings to layers
/ {
    keymap {
        layer_base {
            sensor-bindings = <&inc_dec_kp C_VOL_UP C_VOL_DN>;
        };
    };
};

#include "../config/base.keymap"
#include "../config/lily58.gaming.keymap"
